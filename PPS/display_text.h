#ifndef PPS_PROJECT_DISPLAY_TEXT_H_INCLUDED
#define PPS_PROJECT_DISPLAY_TEXT_H_INCLUDED

#include "secure.h"
#include <cstdint>
#include <cstring>

namespace DisplayText {
constexpr int CYRILLIC_WIDTH=7;
constexpr int CYRILLIC_HEIGHT=11;
constexpr int MAX_ROW_PIXELS=156; // 160 px TFT, preserve 4 px margin
constexpr size_t ROW_BYTES=112;   // up to 26 four-byte UTF-8 codepoints + NUL

// Cyrillic glyph bitmaps derived from DejaVu Sans Mono (10 px).
// Copyright (c) 2003 by Bitstream, Inc. All Rights Reserved.
// Bitstream Vera is a trademark of Bitstream, Inc.
// DejaVu changes are in public domain.
// Permission is hereby granted, free of charge, to any person obtaining a copy
// of the fonts accompanying this license ("Fonts") and associated documentation
// files (the "Font Software"), to reproduce and distribute the Font Software,
// including without limitation the rights to use, copy, merge, publish,
// distribute, and/or sell copies of the Font Software, and to permit persons to
// whom the Font Software is furnished to do so, subject to the following
// conditions:
// The above copyright and trademark notices and this permission notice shall
// be included in all copies of one or more of the Font Software typefaces.
// The Font Software may be modified, altered, or added to, and in particular
// the designs of glyphs or characters in the Fonts may be modified and
// additional glyphs or characters may be added to the Fonts, only if the fonts
// are renamed to names not containing either "Bitstream" or "Vera".
// This license becomes null and void to the extent applicable to Fonts or Font
// Software that has been modified and is distributed under the "Bitstream
// Vera" names.
// The Font Software may be sold as part of a larger software package but no
// copy of one or more of the Font Software typefaces may be sold by itself.
// THE FONT SOFTWARE IS PROVIDED "AS IS", WITHOUT WARRANTY OF ANY KIND,
// EXPRESS OR IMPLIED, INCLUDING BUT NOT LIMITED TO ANY WARRANTIES OF
// MERCHANTABILITY, FITNESS FOR A PARTICULAR PURPOSE AND NONINFRINGEMENT OF
// COPYRIGHT, PATENT, TRADEMARK, OR OTHER RIGHT. IN NO EVENT SHALL BITSTREAM OR
// THE GNOME FOUNDATION BE LIABLE FOR ANY CLAIM, DAMAGES OR OTHER LIABILITY,
// INCLUDING ANY GENERAL, SPECIAL, INDIRECT, INCIDENTAL, OR CONSEQUENTIAL
// DAMAGES, OR ANY OTHER LIABILITY, WHETHER IN AN ACTION OF CONTRACT, TORT OR
// OTHERWISE, ARISING FROM, OUT OF THE USE OR INABILITY TO USE THE FONT SOFTWARE
// OR FROM OTHER DEALINGS IN THE FONT SOFTWARE.
// Except as contained in this notice, the names of Gnome, the Gnome Foundation,
// and Bitstream Inc. shall not be used in advertising or otherwise to promote
// the sale, use or other dealings in this Font Software without prior written
// authorization from the Gnome Foundation or Bitstream Inc., respectively.
// For further information, contact: fonts at gnome dot org.

static const uint8_t CYRILLIC_BITMAPS[98][CYRILLIC_HEIGHT] PROGMEM = {
  { 0x20, 0x00, 0x78, 0x40, 0x40, 0x78, 0x40, 0x40, 0x7C, 0x00, 0x00 }, // U+0400
  { 0x28, 0x00, 0x78, 0x40, 0x40, 0x78, 0x40, 0x40, 0x7C, 0x00, 0x00 }, // U+0401
  { 0x00, 0xF0, 0x40, 0x58, 0x7C, 0x4C, 0x4C, 0x4C, 0x0C, 0x18, 0x00 }, // U+0402
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  { 0x00, 0x08, 0x08, 0x78, 0x40, 0x40, 0x40, 0x40, 0x00, 0x00, 0x00 }, // U+0491
};

inline const uint8_t* cyrillicGlyph(uint32_t cp) {
  if(cp>=0x0400&&cp<=0x045F)return CYRILLIC_BITMAPS[cp-0x0400];
  if(cp==0x0490)return CYRILLIC_BITMAPS[96];
  if(cp==0x0491)return CYRILLIC_BITMAPS[97];
  return nullptr;
}

inline uint32_t nextCodepoint(const unsigned char*& p) {
  if(!*p)return 0;
  uint32_t cp=*p++;
  if(cp<0x80)return cp;
  int more=0;
  if(cp>=0xC2&&cp<=0xDF){cp&=0x1F;more=1;}
  else if(cp>=0xE0&&cp<=0xEF){cp&=0x0F;more=2;}
  else if(cp>=0xF0&&cp<=0xF4){cp&=0x07;more=3;}
  else return '?';
  const unsigned char* q=p;
  uint32_t candidate=cp;
  for(int i=0;i<more;i++){
    if(*q<0x80||*q>0xBF)return '?';
    candidate=(candidate<<6)|(*q++&0x3F);
  }
  if((more==1&&candidate<0x80)||(more==2&&candidate<0x800)||
     (more==3&&candidate<0x10000)||(candidate>=0xD800&&candidate<=0xDFFF)||
     candidate>0x10FFFF)return '?';
  p=q;
  return candidate;
}

inline uint32_t normalize(uint32_t cp) {
  if(cp=='\r')return 0;
  if(cp=='\t'||cp==0xA0)return ' ';
  if(cp=='\n')return cp;
  if(cp>=32&&cp<127)return cp;
  if(cyrillicGlyph(cp))return cp;
  if(cp==0x2013||cp==0x2014||cp==0x2212)return '-';
  if(cp==0x2018||cp==0x2019)return '\'';
  if(cp==0x201C||cp==0x201D)return '"';
  if(cp==0x2116)return '#';
  return '?';
}

inline int glyphWidth(uint32_t cp) {return cyrillicGlyph(cp)?CYRILLIC_WIDTH:6;}

inline size_t writeUtf8(char* dst,uint32_t cp) {
  if(cp<0x80){dst[0]=char(cp);return 1;}
  if(cp<0x800){dst[0]=char(0xC0|(cp>>6));dst[1]=char(0x80|(cp&63));return 2;}
  if(cp<0x10000){dst[0]=char(0xE0|(cp>>12));dst[1]=char(0x80|((cp>>6)&63));dst[2]=char(0x80|(cp&63));return 3;}
  dst[0]=char(0xF0|(cp>>18));dst[1]=char(0x80|((cp>>12)&63));
  dst[2]=char(0x80|((cp>>6)&63));dst[3]=char(0x80|(cp&63));return 4;
}

struct Line {
  char value[ROW_BYTES]{};
  ~Line(){wipe(value,sizeof(value));}
};

class Rows {
  Line visible_[5],empty_;
  size_t first_=0,count_=0;
 public:
  explicit Rows(size_t first=0):first_(first){}
  void reset(size_t first){
    for(auto& line:visible_)wipe(line.value,sizeof(line.value));
    first_=first;count_=0;
  }
  void push_back(const Line& line){
    if(count_>=first_&&count_-first_<5)visible_[count_-first_]=line;
    ++count_;
  }
  size_t size()const{return count_;}
  size_t first()const{return first_;}
  const Line& operator[](size_t absolute)const{
    return absolute>=first_&&absolute-first_<5?visible_[absolute-first_]:empty_;
  }
};

inline void append(Rows& rows,const char* first,const char* second="",const char* third="") {
  Line line;
  size_t n=0;
  int width=0;
  auto emit=[&](){
    if(n){rows.push_back(line);wipe(line.value,sizeof(line.value));n=0;width=0;}
  };
  for(const char* part:{first,second,third}){
    const unsigned char* p=reinterpret_cast<const unsigned char*>(part?part:"");
    while(*p){
      uint32_t cp=nextCodepoint(p);
      if(cp=='\n'){emit();continue;}
      cp=normalize(cp);
      if(!cp)continue;
      const int px=glyphWidth(cp);
      char encoded[4];
      const size_t nb=writeUtf8(encoded,cp);
      if(n&& (width+px>MAX_ROW_PIXELS || n+nb>=sizeof(line.value)))emit();
      if(n+nb>=sizeof(line.value))continue;
      memcpy(line.value+n,encoded,nb);
      n+=nb;line.value[n]=0;width+=px;
    }
  }
  emit();
}
}
#endif
